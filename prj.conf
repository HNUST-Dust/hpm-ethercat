## CMakeLists.txt
```
# Copyright (c) 2025 HPMicro
# SPDX-License-Identifier: Apache-2.0

# generate compile_commands.json for clangd
set(CMAKE_EXPORT_COMPILE_COMMANDS ON)

cmake_minimum_required(VERSION 3.20.0)
find_package(Zephyr REQUIRED HINTS $ENV{ZEPHYR_BASE})
project(hpm6e_ecat_io)

target_include_directories(app PRIVATE
  ${CMAKE_CURRENT_SOURCE_DIR}/src
  ${CMAKE_CURRENT_SOURCE_DIR}/src/bsp
  ${CMAKE_CURRENT_SOURCE_DIR}/src/ssc
  ${CMAKE_CURRENT_SOURCE_DIR}/src/port
  ${HPM_SDK_DIR}/components/eeprom_emulation
  ${HPM_SDK_DIR}/components/eeprom_emulation/port
  ${HPM_SDK_DIR}/utils
)

target_sources(app PRIVATE
  src/main.c
  src/bsp/ecat_zephyr_port.c
  # hpm_sdk EtherCAT port layer
  src/port/hpm_ecat_hw.c
  src/port/hpm_ecat_phy.c
  src/port/hpm_ecat_e2p_emulation.c
  # SSC application layer (generated + customized)
  src/app_layer/app_ethercat.c
  # Beckhoff SSC stack (generated)
  src/ssc/coeappl.c
  src/ssc/ecatappl.c
  src/ssc/ecatcoe.c
  src/ssc/ecatslv.c
  src/ssc/mailbox.c
  src/ssc/objdef.c
  src/ssc/sdoserv.c
  # hpm_sdk drivers not compiled by glue (no HAS_HPMSDK_ESC Kconfig);
  # hpm_gptmr_drv.c is already compiled into the zephyr library by glue
  ${HPM_SDK_DIR}/drivers/src/hpm_esc_drv.c
  # flash eeprom emulation component
  ${HPM_SDK_DIR}/components/eeprom_emulation/eeprom_emulation.c
  ${HPM_SDK_DIR}/components/eeprom_emulation/port/hpm_nor_flash.c
  ${HPM_SDK_DIR}/utils/hpm_crc32.c
)
```

## prj.conf
```kconfig
CONFIG_STDOUT_CONSOLE=y
CONFIG_PRINTK=y

# SSC MainLoop runs in the main thread: preemptible, low priority
CONFIG_MAIN_THREAD_PRIORITY=5
CONFIG_MAIN_STACK_SIZE=4096
```

## app.overlay
```dts
/*
 * Copyright (c) 2025 HPMicro
 * SPDX-License-Identifier: Apache-2.0
 *
 * Reserve 0x200000..0x210000 (64K) for the EtherCAT flash EEPROM emulation
 * used by ecat_e2p_emulation.c. slot1 is shrunk accordingly.
 */

&flash0 {
	partitions {
		slot1_partition: partition@1c3000 {
			reg = <0x1c3000 0x3d000>;
		};

		ecat_eeprom_partition: partition@200000 {
			label = "ecat-eeprom";
			reg = <0x200000 0x10000>;
		};
	};
};
```

## src/main.c
```c
/*
 * Copyright (c) 2025 HPMicro
 *
 * SPDX-License-Identifier: BSD-3-Clause
 *
 * Zephyr port of hpm_sdk samples/ethercat/ecat_io/ecat.c
 */

#include <zephyr/kernel.h>
#include <zephyr/sys/printk.h>
#include <zephyr/drivers/gpio.h>

#include "hpm_soc.h"
#include "ecat_def.h"
#include "ecatappl.h"
#include "ecatslv.h"
#include "applInterface.h"
#include "digital_io.h"
#include "hpm_ecat_hw.h"
#include "ecat_zephyr_port.h"


#define ESC_EEPROM_EMULATION 1

/* RGB LED blink thread, independent of the SSC main loop */
static const struct gpio_dt_spec led_r = GPIO_DT_SPEC_GET(DT_ALIAS(led0), gpios);
static const struct gpio_dt_spec led_g = GPIO_DT_SPEC_GET(DT_ALIAS(led1), gpios);
static const struct gpio_dt_spec led_b = GPIO_DT_SPEC_GET(DT_ALIAS(led2), gpios);

static void led_blink_fn(void *arg1, void *arg2, void *arg3)
{
	ARG_UNUSED(arg1);
	ARG_UNUSED(arg2);
	ARG_UNUSED(arg3);

	const struct gpio_dt_spec leds[] = {led_r, led_g, led_b};

	for (size_t i = 0; i < ARRAY_SIZE(leds); i++) {
		if (!gpio_is_ready_dt(&leds[i])) {
			return;
		}
		gpio_pin_configure_dt(&leds[i], GPIO_OUTPUT_INACTIVE);
	}

	uint32_t count = 0;

	while (1) {
		k_msleep(500);
		gpio_pin_set_dt(&leds[count % ARRAY_SIZE(leds)], 1);
		gpio_pin_set_dt(&leds[(count + ARRAY_SIZE(leds) - 1) % ARRAY_SIZE(leds)], 0);
		count++;
	}
}

/* priority 4 must be HIGHER than main (5): MainLoop is a busy loop, a lower
 * priority thread would starve; this one only wakes every 500ms
 */
K_THREAD_DEFINE(led_blink_tid, 512, led_blink_fn, NULL, NULL, NULL, 4, 0, 0);

/* called by SSC after the master wrote an object via SDO (mailbox path, main loop context) */
static void CoeWriteInd(UINT16 index, UINT8 subindex, BOOL completeAccess)
{
	(void) subindex;
	(void) completeAccess;

	if (index == 0x2000) {
		/* master data already stored in MyMbxData0x2000, consume it here */
		printk("Master wrote 0x2000 = 0x%08x\n", MyMbxData0x2000);
	}
}

int main(void)
{
	hpm_stat_t stat;

	printk("EtherCAT IO sample (Zephyr)\n");

	/* Zephyr port: board_init() equivalent, ESC clock/pins + PHY reset hold */
	ecat_board_init();
	/* Zephyr port: IRQ_CONNECT for ESC/GPTMR before hardware init enables them */
	ecat_irq_init();

	/* hardware init */
	stat = ecat_hardware_init(HPM_ESC);
	if (stat != status_success) {
		printk("Init ESC peripheral and related devices(EEPROM/PHY) failed!\n");
		return 0;
	}

	MainInit(); /* SSC Initilize the stack */
	pAPPL_CoeWriteInd = CoeWriteInd; /* get notified when master writes objects via SDO */

#if defined(ESC_EEPROM_EMULATION) && ESC_EEPROM_EMULATION
	pAPPL_EEPROM_Read = ecat_eeprom_emulation_read;
	pAPPL_EEPROM_Write = ecat_eeprom_emulation_write;
	pAPPL_EEPROM_Reload = ecat_eeprom_emulation_reload;
	pAPPL_EEPROM_Store = ecat_eeprom_emulation_store;
#endif

	/* Create basic mapping */
	APPL_GenerateMapping(&nPdInputSize, &nPdOutputSize);

	/* Set stack run flag */
	bRunApplication = TRUE;
	/* Execute the stack */
	while (bRunApplication == TRUE) {
		MainLoop();
	}

	/* hardware deinit */

	return 0;
}
```
